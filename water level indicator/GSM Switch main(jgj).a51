ORG 00H
LJMP MAIN
ORG 03H
LJMP INTR0
MAIN:
     LCD EQU P2
     BUSY BIT P2.7
	 RS BIT P0.0
     RW BIT P0.1
     E BIT P0.2
	 SENSOR BIT P1.0
     LAMP BIT P0.6
	 LED BIT P0.7
	  
ACALL CMDWRD
MOV R0,#80H
MOV DPTR,#L1
ACALL DISPLAY
MOV R0,#0C0H
MOV DPTR,#L2
ACALL DISPLAY
ACALL DELAY
ACALL CMDWRD
MOV R0,#80H
MOV DPTR,#L3
ACALL DISPLAY
MOV R0,#0C0H
MOV DPTR,#L4
ACALL DISPLAY
ACALL DELAY
ACALL CMDWRD
MOV R0,#80H
MOV DPTR,#L5
ACALL DISPLAY
ACALL DELAY
ACALL CMDWRD
MOV R0,#80H
MOV DPTR,#L6
ACALL DISPLAY
MOV R0,#0C0H
MOV DPTR,#L7
ACALL DISPLAY
ACALL DELAY
ACALL CMDWRD
MOV R0,#80H
MOV DPTR,#L3
ACALL DISPLAY
MOV R0,#0C0H
MOV DPTR,#L4
ACALL DISPLAY
ACALL DELAY

AGAIN:MOV TMOD,#20H
MOV TH1,#-3
MOV SCON,#50H				  
SETB TR1
MOV IE,#81H
MOV DPTR,#LINE2
ACALL SEND
ACALL DELAY
MOV DPTR,#LINE5
ACALL SEND
ACALL DELAY
CLR RI
MOV A,P1
MOV R4,A
MOV R0,#20H
MOV R6,#5
WW:NOP
   JNB RI,WW
   CLR RI
RRR:JNB RI,RRR
   MOV A,SBUF
   MOV @R0,A
   INC R0
   CLR RI
   DJNZ R6,RRR
   MOV R6,#5
   MOV R0,#20H
CHECKMSG:MOV A,@R0
   INC R0
   CJNE A,#43H,DFG
   SJMP MSG
DFG:DJNZ R6,CHECKMSG
   MOV DPTR,#LINE1
   ACALL SEND
   ACALL CMDWRD
   MOV DPTR,#L9
   MOV R0,#80H
   ACALL DISPLAY
   ACALL DELAY
   ACALL STATUS
   LJMP NN

MSG: CLR LED
     ACALL DELAY
     ACALL CMDWRD
	 MOV R0,#80H
     MOV DPTR,#L8
	 ACALL DISPLAY
	 ACALL DELAY

SETB LED
ACALL DELAY
MOV R1,#20H
MOV R6,#82
CLR RI
MOV DPTR,#LINE4
ACALL SEND
HH:JNB RI,HH
   MOV A,SBUF
   MOV @R1,A
   INC R1
   CLR RI
   DJNZ R6,HH
   MOV @R1,#00H
   CLR LED
   ACALL DELAY
   MOV DPTR,#LINE5
   ACALL SEND
   MOV R6,#82
   MOV R0,#24H
AS:MOV A,@R0
   INC R0
   CJNE A,#6CH,QQ
   SJMP OUTT
QQ:DJNZ R6,AS
   ACALL CMDWRD
   MOV DPTR,#L10
   MOV R0,#80H
   ACALL DISPLAY
   ACALL DELAY
   MOV DPTR,#L10
   ACALL SENDMSG
   LJMP NN
OUTT: 
   ACALL CMDWRD
   DEC R0
   MOV R1,00H
   ACALL DISP
   ACALL DELAY
   DEC R1
   MOV A,@R1
   CJNE A,#66H,ONREQ
   JB SENSOR,OFFED
   SETB LAMP
   SETB SENSOR
   MOV DPTR,#L11
   ACALL SENDMSG
   LJMP NN
OFFED:MOV DPTR,#LS4
      ACALL SENDMSG
      ACALL CMDWRD
      MOV R0,#80H
      MOV DPTR,#LS4
	  ACALL DISPLAY
	  ACALL DELAY
	  LJMP NN
ONREQ:JNB SENSOR,ONED
      CLR LAMP
	  CLR SENSOR
      MOV DPTR,#L12
      ACALL SENDMSG
	  ACALL CMDWRD
	  MOV DPTR,#L12
      MOV R0,#80H
	  ACALL DISPLAY
	  ACALL DELAY
      LJMP NN
ONED:MOV DPTR,#LS3
      ACALL SENDMSG
      ACALL CMDWRD
      MOV R0,#80H
      MOV DPTR,#LS3
	  ACALL DISPLAY
	  ACALL DELAY
	  LJMP NN
   
NN:ACALL DELAY


ACALL CMDWRD
MOV R0,#80H
MOV DPTR,#L18
ACALL DISPLAY
ACALL DELAY
ACALL DELAY
ACALL CMDWRD
MOV R0,#80H
MOV DPTR,#L3
ACALL DISPLAY
MOV R0,#0C0H
MOV DPTR,#L4
ACALL DISPLAY
ACALL DELAY
SETB LED
LJMP AGAIN






DISPLAY:MOV A,R0
        ACALL CMD
	LOOP:CLR A
		MOVC A,@A+DPTR
		JZ OUT
		ACALL DAT
		INC DPTR
		SJMP LOOP
	OUT:RET

DISP: MOV A,#80H
      ACALL CMD
	  MOV R2,#08H
LOOP1:CLR A
	  MOV A,@R1
	  ACALL DAT
	  INC R1
	  DJNZ R2,LOOP1
   	  RET

CMD:ACALL READY
    MOV LCD,A
	CLR RS
	CLR RW
	SETB E
	CLR E
	RET
	
DAT:ACALL READY
    MOV LCD,A
	SETB RS
	CLR RW
	SETB E
	CLR E
	RET
	
	 
CMDWRD:MOV A,#38H
       ACALL CMD
	   MOV A,#0CH
	   ACALL CMD
	   MOV A,#01H
	   ACALL CMD
	   MOV A,#06H
	   ACALL CMD
	   RET
	   
READY:SETB BUSY
      CLR RS
	  SETB RW
 BACK:CLR E
      SETB E
	  JB BUSY,BACK
	  RET
	  
DELAY:
      MOV R5,#0FH
  UP3:MOV R6,#0FFH
  UP2:MOV R7,#0FFH
  UP1:DJNZ R7,UP1
	  DJNZ R6,UP2
	  DJNZ R5,UP3
	  RET
	
DELAY2:
      MOV R7,#0FFH
  UPX:DJNZ R7,UPX
	  RET

	  
SEND:CLR TI
  ZZ:CLR A
	 MOVC a,@A+DPTR
	 JZ XX
	 MOV SBUF,A
  YY:JNB TI,YY
     CLR TI
	 INC DPTR
   	 SJMP ZZ
  XX:RET

STATUS:
       JB SENSOR,UU
	   MOV DPTR,#LS1
	   ACALL SENDMSG
	   RET
	UU:MOV DPTR,#LS2
	   ACALL SENDMSG
	   RET
       
SENDMSG:MOV 02H,DPH
        MOV 03H,DPL
		MOV DPTR,#LINE2
		ACALL SEND
		ACALL DELAY2
		MOV DPTR,#LINE3
		ACALL SEND 
		ACALL DELAY2
		MOV DPH,02H
		MOV DPL,03H
		ACALL SEND
		MOV DPTR,#LINE6
		ACALL SEND
		MOV DPTR,#L18
		MOV R0,#80H
		ACALL CMDWRD
		ACALL DISPLAY
		ACALL DELAY
		RET

INTR0:CPL LAMP
      CPL SENSOR
      ACALL DELAY
MOV TMOD,#20H
MOV TH1,#-3
MOV SCON,#50H				  
SETB TR1
MOV DPTR,#LINE2
ACALL SEND
MOV DPTR,#LINE5
ACALL SEND
ACALL DELAY
CLR RI
MOV R0,#20H
MOV R6,#5
      RETI







LINE1:DB "ATH",0DH,0AH,0
LINE2:DB "AT+CMGF=1",0DH,0AH,0
LINE3:DB "AT+CMGS=",22H,30H,39H,38H,38H,31H,37H,36H,37H,34H,39H,36H,22H,0DH,0AH,0
LINE4:DB "AT+CMGR=1",0DH,0AH,0
LINE5:DB "AT+CMGD=1,4",0DH,0AH,0
LINE6:DB 1AH,0


L1:DB "WELCOME TO",0
L2:DB "MY PROJECT",0
L3:DB "GSM switch",0
L4:DB "",0
L5:DB "MADE BY",0
L6:DB "NITIN SONI",0
L7:DB "",0
L8:DB "1 NEW MESSAGE",0
L9:DB "STATUS REQUEST",0
L10:DB "WRONG MESSAGE",0
L11:DB "REQ SUCCESSFUL LAMP OFF",0
L12:DB "REQ SUCCESSFUL LAMP ON",0
L18:DB "MESSAGE SEND",0
L19:DB "THANK YOU",0

LS1:DB "LAMP ON",0
LS2:DB "LAMP OFF",0
LS3:DB "LAMP IS ALL READY ON",0
LS4:DB "LAMP IS ALL READY OFF",0
END