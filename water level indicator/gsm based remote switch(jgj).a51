ORG 00H
     LCD EQU P2
     BUSY BIT P2.7
	 RS BIT P0.0
     RW BIT P0.1
     E BIT P0.2
     MOTOR BIT P0.6
	 LED BIT P0.7
	  
ACALL CMDWRD
MOV R0,#80H
MOV DPTR,#L1
ACALL DISPLAY
MOV R0,#0C0H
MOV DPTR,#L2
ACALL DISPLAY
ACALL DELAY
ACALL CMDWRD
MOV R0,#80H
MOV DPTR,#L3
ACALL DISPLAY
MOV R0,#0C0H
MOV DPTR,#L4
ACALL DISPLAY
ACALL DELAY
ACALL CMDWRD
MOV R0,#80H
MOV DPTR,#L5
ACALL DISPLAY
ACALL DELAY
ACALL CMDWRD
MOV R0,#80H
MOV DPTR,#L6
ACALL DISPLAY
MOV R0,#0C0H
MOV DPTR,#L7
ACALL DISPLAY
ACALL DELAY

AGAIN:
MOV TMOD,#20H
MOV TH1,#-3
MOV SCON,#50H				  
SETB TR1
MOV DPTR,#LINE2
ACALL SEND
ACALL DELAY
MOV DPTR,#LINE5
ACALL SEND
ACALL DELAY
CLR RI
WW:NOP
   ACALL CHECK
   JNB RI,WW
     CLR LED
     ACALL DELAY
     ACALL CMDWRD
	 MOV R0,#80H
     MOV DPTR,#L8
	 ACALL DISPLAY
	 ACALL DELAY

SETB LED
ACALL DELAY
MOV R1,#20H
MOV R6,#82
CLR RI
MOV DPTR,#LINE4
ACALL SEND
HH:JNB RI,HH
   MOV A,SBUF
   MOV @R1,A
   INC R1
   CLR RI
   DJNZ R6,HH
   MOV @R1,#00H
   CLR LED
   ACALL DELAY
   MOV DPTR,#LINE5
   ACALL SEND
   ACALL CMDWRD
   MOV R1,#69H
   ACALL DISP
   ACALL DELAY
   DEC R1
   MOV A,@R1
   CJNE A,#66H,SS
   SETB MOTOR
   JMP NN
SS:CLR MOTOR
NN:ACALL DELAY
   ACALL DELAY
   ACALL DELAY


ACALL CMDWRD
MOV R0,#80H
MOV DPTR,#L15
ACALL DISPLAY
ACALL DELAY
ACALL DELAY
ACALL CMDWRD
MOV R0,#80H
MOV DPTR,#L3
ACALL DISPLAY
MOV R0,#0C0H
MOV DPTR,#L4
ACALL DISPLAY
ACALL DELAY
SETB LED
LJMP AGAIN


DISPLAY:MOV A,R0
        ACALL CMD
	LOOP:CLR A
		MOVC A,@A+DPTR
		JZ OUT
		ACALL DAT
		INC DPTR
		SJMP LOOP
	OUT:RET

DISP: MOV A,#80H
      ACALL CMD
LOOP1:CLR A
	  MOV A,@R1
	  JZ OUT1
	  ACALL DAT
	  INC R1
	  SJMP LOOP1
   	OUT1:RET

CMD:ACALL READY
    MOV LCD,A
	CLR RS
	CLR RW
	SETB E
	CLR E
	RET
	
DAT:ACALL READY
    MOV LCD,A
	SETB RS
	CLR RW
	SETB E
	CLR E
	RET
	
	 
CMDWRD:MOV A,#38H
       ACALL CMD
	   MOV A,#0CH
	   ACALL CMD
	   MOV A,#01H
	   ACALL CMD
	   MOV A,#06H
	   ACALL CMD
	   RET
	   
READY:SETB BUSY
      CLR RS
	  SETB RW
 BACK:CLR E
      SETB E
	  JB BUSY,BACK
	  RET
	  
DELAY:
      MOV R5,#0FH
  UP3:MOV R6,#0FFH
  UP2:MOV R7,#0FFH
  UP1:DJNZ R7,UP1
	  DJNZ R6,UP2
	  DJNZ R5,UP3
	  RET
	  
SEND:CLR TI
  ZZ:CLR A
	 MOVC a,@A+DPTR
	 JZ XX
	 MOV SBUF,A
  YY:JNB TI,YY
     CLR TI
	 INC DPTR
   	 SJMP ZZ
  XX:RET
CHECK:  
      NOP
	  RET


LINE1:DB "ATH",0DH,0AH,0
LINE2:DB "AT+CMGF=1",0DH,0AH,0
LINE3:DB "AT+CMGS=",22H,39H,39H,39H,38H,39H,35H,38H,30H,38H,36H,22H,0DH,0AH,0
LINE4:DB "AT+CMGR=1",0DH,0AH,0
LINE5:DB "AT+CMGD=1,4",0DH,0AH,0
LINE6:DB "",0


L1:DB "WELCOME TO",0
L2:DB "MY PROJECT",0
L3:DB "GSM BASED WATER",0
L4:DB "LEVEL CONTROLLER",0
L5:DB "MADE BY",0
L6:DB "JADEJA JAYDEV",0
L7:DB "PARAS RAVAL",0
L8:DB "1 NEW MESSAGE",0
L9:DB "",0
L10:DB "",0
L11:DB "",0
L12:DB "",0
L13:DB "",0
L14:DB "DATA SEND",0
L15:DB "THANK YOU",0
END